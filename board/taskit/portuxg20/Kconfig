## board/taskit/portuxg20/Kconfig
```kconfig
if TARGET_PORTUXG20

config SYS_BOARD
	default "portuxg20"

config SYS_VENDOR
	default "taskit"

config SYS_CONFIG_NAME
	default "portuxg20"

config PORTUXG20_VDDIOM_1V8
	bool "Select 1.8 V for the EBI memory I/O (VDDIOMSEL = 0)"
	default y
	help
	  The Stamp9G20 module powers its SDRAM/NAND bus (and the PIOC pins)
	  from 1.8 V. The SoC resets with CCFG_EBICSA.VDDIOMSEL = 1 (3.3 V).
	  Say y to clear the bit in the SPL before the SDRAM controller is
	  set up. Say n to leave the reset value untouched.

endif
```

## configs/portuxg20_defconfig
```kconfig
CONFIG_ARM=y
CONFIG_SKIP_LOWLEVEL_INIT_ONLY=y
CONFIG_SPL_SKIP_LOWLEVEL_INIT_ONLY=y
CONFIG_SPL_SYS_ICACHE_OFF=y
CONFIG_SPL_SYS_DCACHE_OFF=y
CONFIG_ARCH_CPU_INIT=y
# CONFIG_SPL_USE_ARCH_MEMCPY is not set
# CONFIG_SPL_USE_ARCH_MEMSET is not set
CONFIG_ARCH_AT91=y
CONFIG_TEXT_BASE=0x21f00000
CONFIG_SYS_MALLOC_LEN=0x400000
CONFIG_TARGET_PORTUXG20=y
CONFIG_AT91_GPIO_PULLUP=y
CONFIG_ATMEL_LEGACY=y
CONFIG_SPL_GPIO=y
CONFIG_SPL_LIBCOMMON_SUPPORT=y
CONFIG_SPL_LIBGENERIC_SUPPORT=y
CONFIG_NR_DRAM_BANKS=1
CONFIG_ENV_SIZE=0x20000
CONFIG_ENV_OFFSET=0x120000
CONFIG_DEFAULT_DEVICE_TREE="at91sam9g20-portuxg20"
CONFIG_SPL_SYS_MALLOC_F_LEN=0x400
CONFIG_SPL_STACK=0x304000
CONFIG_SPL_HAS_BSS_LINKER_SECTION=y
CONFIG_SPL_BSS_START_ADDR=0x20000000
CONFIG_SPL_BSS_MAX_SIZE=0x4000
CONFIG_SYS_LOAD_ADDR=0x22000000
CONFIG_SPL=y
CONFIG_ENV_OFFSET_REDUND=0x160000
CONFIG_NAND_BOOT=y
CONFIG_BOOTDELAY=3
CONFIG_USE_BOOTCOMMAND=y
CONFIG_BOOTCOMMAND="run nfsboot; run nandboot"
CONFIG_SYS_CBSIZE=512
CONFIG_SYS_PBSIZE=537
CONFIG_BOARD_EARLY_INIT_F=y
CONFIG_SPL_MAX_SIZE=0x4000
CONFIG_SPL_PAD_TO=0x20000
# CONFIG_SPL_LEGACY_IMAGE_FORMAT is not set
# CONFIG_SPL_SHARES_INIT_SP_ADDR is not set
CONFIG_SPL_HAVE_INIT_STACK=y
CONFIG_SPL_SYS_MALLOC=y
CONFIG_SPL_HAS_CUSTOM_MALLOC_START=y
CONFIG_SPL_CUSTOM_SYS_MALLOC_ADDR=0x20100000
CONFIG_SPL_SYS_MALLOC_SIZE=0x100000
CONFIG_SPL_NAND_SUPPORT=y
CONFIG_SPL_NAND_RAW_ONLY=y
CONFIG_SPL_NAND_DRIVERS=y
CONFIG_SPL_NAND_ECC=y
CONFIG_SPL_NAND_SOFTECC=y
CONFIG_SPL_NAND_BASE=y
CONFIG_SPL_SERIAL=y
CONFIG_HUSH_PARSER=y
CONFIG_SYS_PROMPT="portuxg20> "
CONFIG_SYS_MAXARGS=32
CONFIG_CMD_BOOTZ=y
CONFIG_CMD_GPIO=y
CONFIG_CMD_MMC=y
CONFIG_CMD_NAND=y
CONFIG_CMD_NAND_TRIMFFS=y
CONFIG_CMD_USB=y
CONFIG_CMD_DHCP=y
CONFIG_CMD_MII=y
CONFIG_CMD_PING=y
CONFIG_CMD_EXT4=y
CONFIG_CMD_FAT=y
CONFIG_CMD_FS_GENERIC=y
CONFIG_CMD_MTDPARTS=y
CONFIG_MTDIDS_DEFAULT="nand0=atmel_nand"
CONFIG_MTDPARTS_DEFAULT="mtdparts=atmel_nand:128k(spl)ro,1M(uboot)ro,256k(env),256k(env_redund),384k(dtb),8M(kernel),16M(rescue),-(ubi)"
CONFIG_CMD_UBI=y
CONFIG_OF_CONTROL=y
CONFIG_ENV_IS_IN_NAND=y
CONFIG_ENV_RANGE=0x40000
CONFIG_ENV_REDUNDANT=y
CONFIG_ENV_RELOC_GD_ENV_ADDR=y
CONFIG_NET_RETRY_COUNT=20
CONFIG_CLK=y
CONFIG_CLK_AT91=y
CONFIG_AT91_GPIO=y
CONFIG_MMC=y
CONFIG_DM_MMC=y
CONFIG_GENERIC_ATMEL_MCI=y
CONFIG_MTD=y
# CONFIG_SYS_NAND_USE_FLASH_BBT is not set
CONFIG_NAND_ATMEL=y
CONFIG_SYS_NAND_BLOCK_SIZE=0x20000
CONFIG_SYS_NAND_PAGE_SIZE=0x800
CONFIG_SYS_NAND_OOBSIZE=0x40
CONFIG_SYS_NAND_U_BOOT_LOCATIONS=y
CONFIG_SYS_NAND_U_BOOT_OFFS=0x20000
CONFIG_MACB=y
CONFIG_RMII=y
CONFIG_PINCTRL=y
CONFIG_PINCTRL_AT91=y
CONFIG_DM_SERIAL=y
CONFIG_ATMEL_USART=y
CONFIG_USB=y
CONFIG_SYS_USB_OHCI_SLOT_NAME="at91sam9260"
CONFIG_USB_ATMEL=y
CONFIG_USB_STORAGE=y
```
